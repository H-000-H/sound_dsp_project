## main/Kconfig.projbuild
```kconfig
menu "ThingsCloud Configuration"

    config THINGSCLOUD_WIFI_SSID
        string "WiFi SSID"
        default "plus"
        help
            WiFi SSID for ThingsCloud connection.

    config THINGSCLOUD_WIFI_PASSWORD
        string "WiFi Password"
        default "22334455hh"
        help
            WiFi password for ThingsCloud connection.

    config THINGSCLOUD_MQTT_URI
        string "MQTT Broker URI"
        default "mqtt://gz-4-mqtt.iot-api.com:1883"
        help
            MQTT broker URI (e.g., mqtt://host:port).

    config THINGSCLOUD_MQTT_CLIENT_ID
        string "MQTT Client ID"
        default "wpzbaryy"
        help
            MQTT client identifier.

    config THINGSCLOUD_MQTT_USERNAME
        string "MQTT Username"
        default "33hsg6n6aygssr8j"
        help
            MQTT authentication username.

    config THINGSCLOUD_MQTT_PASSWORD
        string "MQTT Password"
        default "Ae0toMoRrM"
        help
            MQTT authentication password.

    config THINGSCLOUD_WIFI_TIMEOUT_MS
        int "WiFi Connection Timeout (ms)"
        default 10000
        range 1000 60000
        help
            Maximum time (in milliseconds) to wait for WiFi connection.

endmenu

menu "LVGL Key GPIO Configuration"

    config LVGL_KEY_NEXT_GPIO
        int "NEXT button GPIO number"
        default 16
        range 0 48
        help
            GPIO pin for the NEXT (down) navigation button. Set to -1 to disable.

    config LVGL_KEY_PREV_GPIO
        int "PREV button GPIO number"
        default 17
        range 0 48
        help
            GPIO pin for the PREV (up) navigation button. Set to -1 to disable.

    config LVGL_KEY_ENTER_GPIO
        int "ENTER button GPIO number"
        default 8
        range 0 48
        help
            GPIO pin for the ENTER (confirm) button. Set to -1 to disable.

    config LVGL_KEY_ESC_GPIO
        int "ESC button GPIO number"
        default 3
        range 0 48
        help
            GPIO pin for the ESC (back) button. Set to -1 to disable.

    config LVGL_KEY_DEBOUNCE_MS
        int "Button debounce time (ms)"
        default 50
        range 5 500
        help
            Debounce time in milliseconds for physical buttons.

endmenu

menu "LLM API Configuration"

    config LLM_API_ENABLE
        bool "Enable LLM API client"
        default n
        help
            Enable LLM (Large Language Model) API calling capability.

    config LLM_API_BASE_URL
        string "API Base URL"
        default "https://api.deepseek.com/v1"
        depends on LLM_API_ENABLE
        help
            Base URL for the LLM API (OpenAI-compatible format).

    config LLM_API_KEY
        string "API Key"
        default ""
        depends on LLM_API_ENABLE
        help
            API key for LLM service authentication.

    config LLM_API_MODEL
        string "Model name"
        default "deepseek-chat"
        depends on LLM_API_ENABLE
        help
            Model identifier to use (e.g., deepseek-chat, gpt-4o-mini).

    config LLM_API_TIMEOUT_MS
        int "Request timeout (ms)"
        default 30000
        range 5000 120000
        depends on LLM_API_ENABLE
        help
            HTTP request timeout in milliseconds.

endmenu
```
